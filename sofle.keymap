
  /*
  * Copyright (c) 2020 The ZMK Contributors
  *
  * SPDX-License-Identifier: MIT
  */

  #include <behaviors.dtsi>
  #include <dt-bindings/zmk/keys.h>
  #include <dt-bindings/zmk/bt.h>
  #include <dt-bindings/zmk/ext_power.h>

  / {
    keymap {
      compatible = "zmk,keymap";
  layer0 {
          bindings = <
          [[RGB_M_P]] KC_W1 KC_W2 KC_W3 KC_W4 KC_W5 KC_W6 KC_W7 KC_W8 KC_W9 KC_W0 [[RGB_TOG]] [[RGB_M_SW]] &kp Q &kp W &kp F &kp P &kp B &kp J &kp L &kp U &kp Y &kp SINGLE_QUOTE [[RGB_HUI]] [[RGB_M_G]] &mt LEFT_GUI A &mt LEFT_ALT R &mt LEFT_CONTROL S &mt LEFT_SHIFT T &kp G &kp M &mt LEFT_SHIFT N &mt LEFT_CONTROL E &mt LEFT_ALT I &mt LEFT_GUI O [[RGB_SAI]] &tog 6 &kp Z ALGR_T(KC_X &kp C &kp D &kp V &none &none &kp K &kp H &kp COMMA ALGR_T(KC_DOT &kp SLASH [[RGB_VAI]] &kp LEFT_GUI &kp LG(J) &kp ESCAPE &lt 1 SPACE &lt 4 TAB &lt 5 ENTER &lt 2 BACKSPACE &lt 3 DELETE &kp LG(COMMA) &kp RIGHT_GUI
          >;
        };layer1 {
          bindings = <
          &trans &trans &trans &trans &trans &trans &trans &trans &trans &trans &trans &trans &trans &kp INSERT &kp PRINTSCREEN &kp K_APPLICATION &none &none &kp PAGE_UP KC_PRVWD KC_NXTWD KC_DLINE &kp BACKSPACE &trans &trans &kp LEFT_GUI &kp LEFT_ALT &kp LEFT_CONTROL &kp LEFT_SHIFT &none [[CW_TOGG]] &kp LEFT &kp DOWN &kp UP &kp RIGHT &kp BACKSPACE &trans &kp K_UNDO &kp K_CUT &kp K_COPY &kp K_PASTE &none &trans &trans &none &kp HOME &kp PAGE_DOWN &kp PAGE_UP KC_LEND &trans &trans &trans &trans &trans &trans &kp ENTER &kp BACKSPACE &kp DELETE &trans &trans
          >;
        };layer2 {
          bindings = <
          &trans &kp EQUAL &kp MINUS [[KC_PLUS]] [[KC_LCBR]] [[KC_RCBR]] &kp LEFT_BRACKET &kp RIGHT_BRACKET &kp SEMICOLON [[KC_COLN]] &kp BACKSLASH &trans &trans &kp LEFT_BRACKET &kp N7 &kp N8 &kp N9 &kp RIGHT_BRACKET &kp F6 &kp F7 &kp F8 &kp F9 &kp F10 &kp F11 &kp GRAVE &kp SEMICOLON &kp N4 &kp N5 &kp N6 &kp EQUAL &none &kp LEFT_SHIFT &kp LEFT_CONTROL &kp LEFT_ALT &kp LEFT_GUI &none &trans &kp GRAVE &kp N1 &kp N2 &kp N3 &kp BACKSLASH &trans &trans [[KC_CIRC]] [[KC_AMPR]] &trans &trans [[KC_RPRN]] [[KC_PIPE]] &trans &trans [[KC_LPRN]] &kp N0 &kp MINUS &trans &trans &trans &trans &trans
          >;
        };layer3 {
          bindings = <
          &trans &kp EQUAL &kp MINUS [[KC_PLUS]] [[KC_LCBR]] [[KC_RCBR]] &kp LEFT_BRACKET &kp RIGHT_BRACKET &kp SEMICOLON [[KC_COLN]] &kp BACKSLASH &trans &trans &kp F12 &kp F7 &kp F8 &kp F9 &kp RIGHT_BRACKET &kp F6 &kp F7 &kp F8 &kp F9 &kp F10 &kp F11 &kp GRAVE &kp F11 &kp F4 &kp F5 &kp F6 &kp EQUAL &none &kp LEFT_SHIFT &kp LEFT_CONTROL &kp LEFT_ALT &kp LEFT_GUI &none &trans &kp F10 &kp F1 &kp F2 &kp F3 &kp BACKSLASH &trans &trans [[KC_CIRC]] [[KC_AMPR]] [[KC_ASTR]] [[KC_LPRN]] [[KC_RPRN]] [[KC_PIPE]] &trans &trans &kp K_APPLICATION &kp SPACE &kp TAB &trans &trans &trans &trans &trans
          >;
        };layer4 {
          bindings = <
          &trans &trans &trans &trans &trans &trans &trans &trans &trans &trans &trans &trans &trans &trans &trans &trans &trans &trans &trans &trans &trans &trans &trans &trans &trans &kp LEFT_GUI &kp LEFT_ALT &kp LEFT_CONTROL &kp LEFT_SHIFT &none &none [[KC_MS_L]] [[KC_MS_D]] [[KC_MS_U]] [[KC_MS_R]] &kp BACKSPACE &trans &trans &trans &trans &trans &trans &trans &trans &trans [[KC_WH_L]] [[KC_WH_D]] [[KC_WH_U]] [[KC_WH_R]] &trans &trans &trans &trans &trans &trans [[KC_BTN1]] [[KC_BTN3]] [[KC_BTN2]] &trans &trans
          >;
        };layer5 {
          bindings = <
          &none &none &none &none &none &none &none &none &none &none &none &none &none &none &none &kp GRAVE [[KC_TILD]] &none &none &none &none &none &none &none &none [[KC_LCBR]] &kp LEFT_BRACKET [[KC_LPRN]] &kp SINGLE_QUOTE &kp SLASH &none &kp LEFT_SHIFT &kp LEFT_CONTROL &kp LEFT_ALT &kp LEFT_GUI &none &none [[KC_RCBR]] &kp RIGHT_BRACKET [[KC_RPRN]] [[KC_DQUO]] &kp BACKSLASH &none &none &none &none &none &none &none &none &none &none [[KC_LT]] [[KC_GT]] [[KC_UNDS]] &none &none &none &none &none
          >;
        };layer6 {
          bindings = <
          &kp GRAVE &kp N1 &kp N2 &kp N3 &kp N4 &kp N5 &kp N6 &kp N7 &kp N8 &kp N9 &kp N0 &kp GRAVE &kp ESCAPE &kp Q &kp E &kp W &kp R &kp T &kp Y &kp U &kp I &kp O &kp P &kp BACKSPACE &kp TAB &kp F &kp A &kp S &kp D &kp G &kp H &kp N1 &kp N2 &kp N3 &kp SEMICOLON &kp SINGLE_QUOTE &tog 6 &kp Z &kp X &kp C &kp V &kp B &none &none &kp N &kp M &kp COMMA &kp DOT &kp SLASH &kp RIGHT_SHIFT &kp LEFT_GUI &kp LEFT_CONTROL &kp ESCAPE &kp SPACE &kp LEFT_SHIFT &kp ENTER &kp BACKSPACE &kp RIGHT_CONTROL &kp RIGHT_ALT &kp RIGHT_GUI
          >;
        };
    };
  };
  
